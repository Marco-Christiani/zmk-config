## config/west.yml
```yaml
# manifest:
#   remotes:
#     - name: zmkfirmware
#       url-base: https://github.com/zmkfirmware
#     - name: infused-kim
#       url-base: https://github.com/infused-kim
#     # Another fix to try
#     - name: bobobo1618
#       url-base: https://github.com/bobobo1618/zephyr/tree/fix-oled
#   projects:
#    - name: zmk
#      remote: infused-kim
#      revision: v2.5.0+zmk-fixes+kim-fixes # oled patch
#       # clone-depth: 1 # hmm
#     - name: zmk
#       remote: bobobo1618
#       revision: main
#       import: app/west.yml
#   self:
#     path: config
# Uncomment when oled + ep_tog is fixed upstream
manifest:
  remotes:
    - name: zmkfirmware
      url-base: https://github.com/zmkfirmware
  projects:
    - name: zmk
      remote: zmkfirmware
      revision: main
      import: app/west.yml
  self:
    path: config
```
